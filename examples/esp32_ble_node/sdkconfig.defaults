## examples/esp32_ble_node/sdkconfig.defaults
```kconfig
# AIngle ESP32 BLE Node Configuration
# =====================================

# Rust toolchain settings
CONFIG_ESP_MAIN_TASK_STACK_SIZE=32768
CONFIG_PTHREAD_TASK_STACK_SIZE_DEFAULT=8192

# Bluetooth - Enable NimBLE stack
CONFIG_BT_ENABLED=y
CONFIG_BT_BLE_ENABLED=y
CONFIG_BT_BLUEDROID_ENABLED=n
CONFIG_BT_NIMBLE_ENABLED=y

# NimBLE Configuration
CONFIG_BT_NIMBLE_MAX_CONNECTIONS=4
CONFIG_BT_NIMBLE_MAX_BONDS=3
CONFIG_BT_NIMBLE_MAX_CCCDS=8
CONFIG_BT_NIMBLE_L2CAP_COC_MAX_NUM=0
CONFIG_BT_NIMBLE_ROLE_CENTRAL=y
CONFIG_BT_NIMBLE_ROLE_PERIPHERAL=y
CONFIG_BT_NIMBLE_ROLE_BROADCASTER=y
CONFIG_BT_NIMBLE_ROLE_OBSERVER=y

# Security - Enable bonding persistence
CONFIG_BT_NIMBLE_NVS_PERSIST=y
CONFIG_BT_NIMBLE_SM_LEGACY=y
CONFIG_BT_NIMBLE_SM_SC=y

# GATT Configuration
CONFIG_BT_NIMBLE_GATT_MAX_PROCS=4
CONFIG_BT_NIMBLE_ATT_PREFERRED_MTU=256

# Advertising
CONFIG_BT_NIMBLE_EXT_ADV=n

# Memory optimization
CONFIG_BT_NIMBLE_MEM_ALLOC_MODE_INTERNAL=y
CONFIG_BT_NIMBLE_TASK_STACK_SIZE=4096
CONFIG_BT_NIMBLE_HOST_TASK_STACK_SIZE=4096

# Logging (reduce for production)
CONFIG_BT_NIMBLE_LOG_LEVEL_WARNING=y

# WiFi - Disable to save memory (BLE only)
CONFIG_ESP_WIFI_ENABLED=n

# Power management
CONFIG_PM_ENABLE=y
CONFIG_PM_DFS_INIT_AUTO=y
CONFIG_ESP_SLEEP_POWER_DOWN_FLASH=y

# Flash
CONFIG_ESPTOOLPY_FLASHSIZE_4MB=y
CONFIG_PARTITION_TABLE_SINGLE_APP=y

# Watchdog
CONFIG_ESP_TASK_WDT_TIMEOUT_S=30
```
